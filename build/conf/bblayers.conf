## build/conf/bblayers.conf
```bitbake
# POKY_BBLAYERS_CONF_VERSION is increased each time build/conf/bblayers.conf
# changes incompatibly
POKY_BBLAYERS_CONF_VERSION = "2"

BBPATH = "${TOPDIR}"
BBFILES ?= ""

BBLAYERS ?= " \
  /home/user/EL/poky/meta \
  /home/user/EL/poky/meta-poky \
  /home/user/EL/poky/meta-yocto-bsp \
  /home/user/EL/poky/meta-openembedded/meta-oe \
  /home/user/EL/poky/meta-openembedded/meta-python \
  /home/user/EL/poky/meta-arm/meta-arm-toolchain \
  /home/user/EL/poky/meta-arm/meta-arm \
  /home/user/EL/poky/meta-sunxi \
  /home/user/EL/poky/meta-mylayer \
  "
```

## conf/layer.conf
```bitbake
# We have a conf and classes directory, add to BBPATH
BBPATH .= ":${LAYERDIR}"

# We have recipes-* directories, add to BBFILES
BBFILES += "${LAYERDIR}/recipes-*/*/*.bb \
            ${LAYERDIR}/recipes-*/*/*.bbappend"

BBFILE_COLLECTIONS += "meta-mylayer"
BBFILE_PATTERN_meta-mylayer = "^${LAYERDIR}/"
BBFILE_PRIORITY_meta-mylayer = "11"

LAYERDEPENDS_meta-mylayer = "core sunxi doom"
LAYERSERIES_COMPAT_meta-mylayer = "mickledore"
```
